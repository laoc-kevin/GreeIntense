#include <bsp_int.h>
#include <lib_def.h>
#include <os.h>
#include "lpc_gpio.h"
#include "lpc_clkpwr.h"
#include "lpc_timer.h"
#include "lpc_mbdriver.h"
#include "lpc_Pinsel.h"

#include <LPC407x_8x_177x_8x.h>

/**********************************************************************
 * @brief   UART初始化
 * @param   *Uart   UART
 * @return	none
 *********************************************************************/
void MB_UartInit(const sUART_Def *Uart)
{
	uint8_t UartIntID = 0;  
	UART_CFG_Type UARTCfg = Uart->UARTCfg;    //Uart串口基本设置
		
	UART_FIFO_CFG_Type UARTFIFOCfg;
	UARTFIFOCfg.FIFO_DMAMode = DISABLE;
	UARTFIFOCfg.FIFO_Level = UART_FIFO_TRGLEV2;
	UARTFIFOCfg.FIFO_ResetRxBuf = ENABLE;
	UARTFIFOCfg.FIFO_ResetTxBuf = ENABLE;
	
	//UART_DE
	GPIO_SetDir(Uart->DE->Port , 1<<Uart->DE->Pin, 1);
	GPIO_SetValue(Uart->DE->Port, 1<<Uart->DE->Pin);
		
	//UART_INV
	GPIO_SetDir(Uart->INV->Port, 1<<Uart->INV->Pin, 1);
	GPIO_ClearValue(Uart->INV->Port, 1<<Uart->INV->Pin);
	
	switch(Uart->ID)
	{
		case UART_0:
			(void)PINSEL_ConfigPin(Uart->Txd->Port, Uart->Txd->Pin, 1);
	        (void)PINSEL_ConfigPin(Uart->Rxd->Port, Uart->Rxd->Pin, 1);
		    UartIntID = BSP_INT_ID_UART0;
	    break;
		
		case UART_1:
		    (void)PINSEL_ConfigPin(Uart->Txd->Port, Uart->Txd->Pin, 2);   //管脚配置必须参考芯片手册，不同的UART的管脚配置不同
	        (void)PINSEL_ConfigPin(Uart->Rxd->Port, Uart->Rxd->Pin, 2);
		    UartIntID = BSP_INT_ID_UART1;
		break;
		
		case UART_2:
		    UartIntID = BSP_INT_ID_UART2;
	    break;
		
		case UART_3:
		    UartIntID = BSP_INT_ID_UART3;
		break;
		
		case UART_4:
		    UartIntID = BSP_INT_ID_UART4;
		break;
		
		default: break;
	}
	
	UART_Init(Uart->ID, &UARTCfg);         					//串口初始化
	UART_FIFOConfig(Uart->ID, &UARTFIFOCfg);  				//FIFO控制寄存器设置
	UART_IntConfig(Uart->ID, UART_INTCFG_RBR, ENABLE); 		//串口中断设置   接收中断
	BSP_IntEn(UartIntID);                                 	//外部中断使能
//  NVIC_SetPriority(UART1_IRQn, ((0x01<<3)|0x01));
//	NVIC_EnableIRQ(UART1_IRQn);
	UART_TxCmd(Uart->ID, ENABLE);                           //UART发送使能
}

/**********************************************************************
 * @brief   485总线接收或者发送
 * @param   *Uart   UART
 * @param   mode    0：接收
 * 					1：发送
 * @return	none
 *********************************************************************/
void MB_SendOrRecive(const sUART_Def *Uart, eUART_EN mode)
{
	GPIO_SetDir(Uart->DE->Port, 1<<Uart->DE->Pin , 1);
   
	if(mode == UART_TX_EN)
	{
		GPIO_SetValue(Uart->DE->Port, 1<<Uart->DE->Pin);
	}
	else if(mode == UART_RX_EN)
	{
		GPIO_ClearValue(Uart->DE->Port, 1<<Uart->DE->Pin);
	}
}

/**********************************************************************
 * @brief   ModbusCRC校验
 * @param   *Data        8位byte数据指针
 * @param   DataSize     参与校验数据byte数
 * @param   StartIndex   开始位置
 * @return	uint16_t      校验值
 *********************************************************************/
uint16_t MB_CRCCalc(const uint8_t *Data,uint8_t StartIndex, uint16_t DataSize)			//CRC校验码计算函数
{
	uint8_t i = 0;
	uint8_t j = 0;
	uint8_t tmp = 0;
	uint16_t CRCCode = 0;
	CRCCode = 0xFFFF;
	for (j = StartIndex; j < DataSize; j++)
	{
		CRCCode = CRCCode ^ (*(Data + j));
		for (i = 0; i < 8; i++)
		{
			tmp = CRCCode & 0x0001;
			CRCCode = (CRCCode >> 1);
			if (tmp == 1)
			{
				CRCCode = (CRCCode ^ 0xA001);
			}
		}
	}	
	return CRCCode;
}

static const UCHAR aucCRCHi[] = {
    0x00, 0xC1, 0x81, 0x40, 0x01, 0xC0, 0x80, 0x41, 0x01, 0xC0, 0x80, 0x41,
    0x00, 0xC1, 0x81, 0x40, 0x01, 0xC0, 0x80, 0x41, 0x00, 0xC1, 0x81, 0x40,
    0x00, 0xC1, 0x81, 0x40, 0x01, 0xC0, 0x80, 0x41, 0x01, 0xC0, 0x80, 0x41,
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    0x00, 0xC1, 0x81, 0x40
};

static const UCHAR aucCRCLo[] = {
    0x00, 0xC0, 0xC1, 0x01, 0xC3, 0x03, 0x02, 0xC2, 0xC6, 0x06, 0x07, 0xC7,
    0x05, 0xC5, 0xC4, 0x04, 0xCC, 0x0C, 0x0D, 0xCD, 0x0F, 0xCF, 0xCE, 0x0E,
    0x0A, 0xCA, 0xCB, 0x0B, 0xC9, 0x09, 0x08, 0xC8, 0xD8, 0x18, 0x19, 0xD9,
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    0x41, 0x81, 0x80, 0x40
};

uint16_t usMBCRC16( UCHAR * pucFrame, USHORT usLen )
{
    UCHAR ucCRCHi = 0xFF;
    UCHAR ucCRCLo = 0xFF;
	
    int   iIndex;

    while( usLen-- )
    {
        iIndex = ucCRCLo ^ *( pucFrame++ );
        ucCRCLo = ( UCHAR )( ucCRCHi ^ aucCRCHi[iIndex] );
        ucCRCHi = aucCRCLo[iIndex];
    }
    return ( USHORT )( ucCRCHi << 8 | ucCRCLo );
}

void EnterCriticalSection( void )
{
//	__SETPRIMASK();
	__disable_irq();

}

void ExitCriticalSection( void )
{
//	__RESETPRIMASK();
	__enable_irq();
}
